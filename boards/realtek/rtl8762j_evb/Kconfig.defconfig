## boards/realtek/rtl8762j_evb/Kconfig.defconfig
```kconfig
# Copyright (c) 2024 Realtek Semiconductor Corp.
# SPDX-License-Identifier: Apache-2.0
if BOARD_RTL8762J_EVB

config BOARD
	default "rtl8762j_evb"

# config SERIAL
# 	default y

# config UART_INTERRUPT_DRIVEN
# 	default y

# config CONSOLE
# 	default y

# config UART_CONSOLE
# 	default CONSOLE

endif #BOARD_RTL8762J_EVB
```

## boards/realtek/rtl8762j_evb/Kconfig.rtl8762j_evb
```kconfig
# Copyright (c) 2024 Realtek Semiconductor Corp.
# SPDX-License-Identifier: Apache-2.0
config BOARD_RTL8762J_EVB
	select SOC_RTL8762JX
```

## boards/realtek/rtl87x3g_evb/Kconfig.defconfig
```kconfig
# Copyright (c) 2024 Realtek Semiconductor Corp.
# SPDX-License-Identifier: Apache-2.0
if BOARD_RTL87X3G_EVB

config BOARD
	default "rtl87x3g_evb"

endif #BOARD_RTL87X3G_EVB
```

## boards/realtek/rtl87x3g_evb/Kconfig.rtl87x3g_evb
```kconfig
# Copyright (c) 2024 Realtek Semiconductor Corp.
# SPDX-License-Identifier: Apache-2.0
config BOARD_RTL87X3G_EVB
	select SOC_RTL8773GTP
```

## drivers/adc/Kconfig.rtl87x3g
```kconfig
# RTL87X3G adc configuration

# Copyright(c) 2025, Realtek Semiconductor Corporation.
# SPDX-License-Identifier: Apache-2.0

config ADC_RTL87X3G
   bool "RTL87X3G MCU adc driver"
   default y
   depends on DT_HAS_REALTEK_RTL87X3G_ADC_ENABLED
   select USE_HAL_REALTEK_ADC
   select ADC_ASYNC
   help
     Enable the RTL87X3G adc driver.
```

## drivers/clock_control/Kconfig.rtl87x3g
```kconfig
# RTL87X3G clock control configuration

# Copyright(c) 2025, Realtek Semiconductor Corporation.
# SPDX-License-Identifier: Apache-2.0

config CLOCK_CONTROL_RTL87X3G
	bool "RTL87X3G clock control"
	default y
	depends on DT_HAS_REALTEK_RTL87X3G_CCTL_ENABLED
	select USE_HAL_REALTEK_RCC
	help
	  Enable driver for RTL87X3G Reset Clock Unit (RCU).
```

## drivers/counter/Kconfig.rtl87x3g_rtc
```kconfig
# RTL87X3G counter rtc configuration

# Copyright(c) 2024, Realtek Semiconductor Corporation.
# SPDX-License-Identifier: Apache-2.0

config COUNTER_RTC_RTL87X3G
	bool "RTL87X3G rtc counter driver"
	default y if !RTC_RTL87X3G
	depends on DT_HAS_REALTEK_RTL87X3G_RTC_ENABLED
	select USE_HAL_REALTEK_RTC
	help
	  Enable the RTL87X3G counter rtc driver.
```

## drivers/counter/Kconfig.rtl87x3g_timer
```kconfig
# RTL87X3G counter timer configuration

# Copyright(c) 2025, Realtek Semiconductor Corporation.
# SPDX-License-Identifier: Apache-2.0

config COUNTER_TIMER_RTL87X3G
	bool "RTL87X3G timer counter driver"
	default y
	depends on DT_HAS_REALTEK_RTL87X3G_TIMER_ENABLED
	select USE_HAL_REALTEK_TIM
	help
	  Enable the RTL87X3G counter timer driver.
```

## drivers/disk/Kconfig.flash
```kconfig
# Copyright (c) 2016 Intel Corporation
# SPDX-License-Identifier: Apache-2.0

config DISK_DRIVER_FLASH
	bool "Flash"
	select FLASH
	select FLASH_MAP
	help
	  Flash device is used for the file system.

config DISK_DRIVER_FLASH_RTK
	bool "Flash RTK"
	depends on SOC_SERIES_RTL87X3G
	help
	  RTK Flash device is used for the file system.

config DISK_DRIVER_NAND_FLASH_RTK
	bool "NAND Flash RTK"
	depends on SOC_SERIES_RTL87X3G
	help
	  RTK NAND Flash device is used for the file system.

if DISK_DRIVER_FLASH

config FLASHDISK_VERIFY_PAGE_LAYOUT
	bool "Verify flashdisk partition layout"
	default y
	help
	  Enable runtime zephyr,flash-disk partition page layout constraints
	  verification. Disable to reduce code size.

module = FLASHDISK
module-str = flashdisk
source "subsys/logging/Kconfig.template.log_config"

endif # DISK_DRIVER_FLASH
```

## drivers/dma/Kconfig.rtl87x3g
```kconfig
# RTL87X3G dma configuration

# Copyright(c) 2024, Realtek Semiconductor Corporation.
# SPDX-License-Identifier: Apache-2.0

config DMA_RTL87X3G
	bool "RTL87X3G MCU DMA driver"
	default y
	depends on DT_HAS_REALTEK_RTL87X3G_DMA_ENABLED
	select USE_HAL_REALTEK_DMA
	help
	  Enable the RTL87X3G dma driver.
```

## drivers/flash/Kconfig.rtl87x3g_nor
```kconfig
#
# Copyright (c) 2026, Realtek Semiconductor Corporation
#
# SPDX-License-Identifier: Apache-2.0
#

config FLASH_RTL87X3G_NOR
	bool "Enable Realtek RTL87X3G Nor Flash Driver"
	default y
	depends on DT_HAS_REALTEK_RTL87X3G_NOR_FLASH_CONTROLLER_ENABLED
	select FLASH_HAS_DRIVER_ENABLED
	select FLASH_HAS_PAGE_LAYOUT
	select FLASH_HAS_EXPLICIT_ERASE
	help
	  Enable Realtek RTL87X3G NOR Flash Driver.
```

## drivers/gpio/Kconfig.rtl87x3g
```kconfig
# RTL87X3G gpio configuration

# Copyright(c) 2025, Realtek Semiconductor Corporation.
# SPDX-License-Identifier: Apache-2.0

menuconfig GPIO_RTL87X3G
	bool "RTL87X3G MCU GPIO driver"
	default y
	select USE_HAL_REALTEK_GPIO
	depends on DT_HAS_REALTEK_RTL87X3G_GPIO_ENABLED
	help
	  Enable the RTL87X3G gpio driver.

if GPIO_RTL87X3G && SOC_SERIES_RTL87X3G

config RTL87X3G_USE_P10_4_AS_GPIOA11
	bool "Use P10_4 as GPIOA_11"
	default n
	help
	  If true, use P10_4 as GPIOA_11, else use P1_4.

config RTL87X3G_USE_P10_5_AS_GPIOA12
	bool "Use P10_5 as GPIOA_12"
	default n
	help
	  If true, use P10_5 as GPIOA_12, else use P1_5.

config RTL87X3G_USE_P10_6_AS_GPIOA13
	bool "Use P10_6 as GPIOA_13"
	default n
	help
	  If true, use P10_6 as GPIOA_13, else use P5_4.

config RTL87X3G_USE_SPIC3_SIO2_AS_GPIOA14
	bool "Use SPIC3_SIO2 as GPIOA_14"
	default n
	help
	  If true, use SPIC3_SIO2 as GPIOA_14, else use P5_5.

config RTL87X3G_USE_P5_6_AS_GPIOA15
	bool "Use P5_6 as GPIOA_15"
	default n
	help
	  If true, use P5_6 as GPIOA_15, else use P2_0.

config RTL87X3G_USE_SPIC3_CSN_AS_GPIOA16
	bool "Use SPIC3_CSN as GPIOA_16"
	default n
	help
	  If true, use SPIC3_CSN as GPIOA_16, else use P2_1.

config RTL87X3G_USE_SPIC3_SIO0_AS_GPIOA17
	bool "Use SPIC3_SIO0 as GPIOA_17"
	default n
	help
	  If true, use SPIC3_SIO0 as GPIOA_17, else use P2_2.

config RTL87X3G_USE_MIC1_P_AS_GPIOA25
	bool "Use MIC1_P as GPIOA_25"
	default n
	help
	  If true, use MIC1_P as GPIOA_25, else use P6_0.

config RTL87X3G_USE_MIC1_N_AS_GPIOA26
	bool "Use MIC1_N as GPIOA_26"
	default n
	help
	  If true, use MIC1_N as GPIOA_26, else use P6_1.

config RTL87X3G_USE_MIC2_P_AS_GPIOA27
	bool "Use MIC2_P as GPIOA_27"
	default n
	help
	  If true, use MIC2_P as GPIOA_27, else use P6_2.

config RTL87X3G_USE_MIC2_N_AS_GPIOA28
	bool "Use MIC2_N as GPIOA_28"
	default n
	help
	  If true, use MIC2_N as GPIOA_28, else use P6_3.

config RTL87X3G_USE_MICBIAS1_AS_GPIOA29
	bool "Use MICBIAS1 as GPIOA_29"
	default n
	help
	  If true, use MICBIAS1 as GPIOA_29, else use P6_4.

config RTL87X3G_USE_SPIC3_SCK_AS_GPIOA30
	bool "Use SPIC3_SCK as GPIOA_30"
	default n
	help
	  If true, use SPIC3_SCK as GPIOA_30, else use DAOUT1_P.

config RTL87X3G_USE_SPIC3_SIO3_AS_GPIOA31
	bool "Use SPIC3_SIO3 as GPIOA_31"
	default n
	help
	  If true, use SPIC3_SIO3 as GPIOA_31, else use DAOUT1_N.

config RTL87X3G_USE_LOUT_P_AS_GPIOB7
	bool "Use LOUT_P as GPIOB_7"
	default n
	help
	  If true, use LOUT_P as GPIOB_7, else use P4_0.

config RTL87X3G_USE_LOUT_N_AS_GPIOB8
	bool "Use LOUT_N as GPIOB_8"
	default n
	help
	  If true, use LOUT_N as GPIOB_8, else use P4_1.

config RTL87X3G_USE_ROUT_P_AS_GPIOB9
	bool "Use ROUT_P as GPIOB_9"
	default n
	help
	  If true, use ROUT_P as GPIOB_9, else use P4_2.

config RTL87X3G_USE_ROUT_N_AS_GPIOB10
	bool "Use ROUT_N as GPIOB_10"
	default n
	help
	  If true, use ROUT_N as GPIOB_10, else use P4_3.

config RTL87X3G_USE_MICBIAS2_AS_GPIOB12
	bool "Use MICBIAS2 as GPIOB_12"
	default n
	help
	  If true, use MICBIAS2 as GPIOB_12, else use P4_5.

config RTL87X3G_USE_DAOUT2_P_AS_GPIOB13
	bool "Use DAOUT2_P as GPIOB_13"
	default n
	help
	  If true, use DAOUT2_P as GPIOB_13, else use P4_6.

config RTL87X3G_USE_DAOUT2_N_AS_GPIOB14
	bool "Use DAOUT2_N as GPIOB_14"
	default n
	help
	  If true, use DAOUT2_N as GPIOB_14, else use P4_7.

config RTL87X3G_USE_P7_0_AS_GPIOB15
	bool "Use P7_0 as GPIOB_15"
	default n
	help
	  If true, use P7_0 as GPIOB_15, else use P5_0.

config RTL87X3G_USE_P7_1_AS_GPIOB16
	bool "Use P7_1 as GPIOB_16"
	default n
	help
	  If true, use P7_1 as GPIOB_16, else use P5_1.

config RTL87X3G_USE_P7_2_AS_GPIOB17
	bool "Use P7_2 as GPIOB_17"
	default n
	help
	  If true, use P7_2 as GPIOB_17, else use P5_2.

config RTL87X3G_USE_P7_3_AS_GPIOB18
	bool "Use P7_3 as GPIOB_18"
	default n
	help
	  If true, use P7_3 as GPIOB_18, else use P5_3.

config RTL87X3G_USE_P8_6_AS_GPIOB19
	bool "Use P8_6 as GPIOB_19"
	default n
	help
	  If true, use P8_6 as GPIOB_19, else use P7_4.

config RTL87X3G_USE_P8_7_AS_GPIOB20
	bool "Use P8_7 as GPIOB_20"
	default n
	help
	  If true, use P8_7 as GPIOB_20, else use P7_5.

config RTL87X3G_USE_P7_6_AS_GPIOB21
	bool "Use P7_6 as GPIOB_21"
	default n
	help
	  If true, use P7_6 as GPIOB_21, else use ADC_4.

config RTL87X3G_USE_SPIC3_SIO1_AS_GPIOB22
	bool "Use SPIC3_SIO1 as GPIOB_22"
	default n
	help
	  If true, use SPIC3_SIO1 as GPIOB_22, else use ADC_5.

config RTL87X3G_USE_SPIC1_SIO2_AS_GPIOB23
	bool "Use SPIC1_SIO2 as GPIOB_23"
	default n
	help
	  If true, use SPIC1_SIO2 as GPIOB_23, else use ADC_6.

config RTL87X3G_USE_SPIC1_SIO1_AS_GPIOB24
	bool "Use SPIC1_SIO1 as GPIOB_24"
	default n
	help
	  If true, use SPIC1_SIO1 as GPIOB_24, else use ADC_7.

config RTL87X3G_USE_SPIC1_CSN_AS_GPIOB25
	bool "Use SPIC1_CSN as GPIOB_25"
	default n
	help
	  If true, use SPIC1_CSN as GPIOB_25, else use P3_5.

config RTL87X3G_USE_SPIC1_SIO0_AS_GPIOB26
	bool "Use SPIC1_SIO0 as GPIOB_26"
	default n
	help
	  If true, use SPIC1_SIO0 as GPIOB_26, else use P8_0.

config RTL87X3G_USE_SPIC1_SCK_AS_GPIOB27
	bool "Use SPIC1_SCK as GPIOB_27"
	default n
	help
	  If true, use SPIC1_SCK as GPIOB_27, else use P8_1.

config RTL87X3G_USE_SPIC1_SIO3_AS_GPIOB28
	bool "Use SPIC1_SIO3 as GPIOB_28"
	default n
	help
	  If true, use SPIC1_SIO3 as GPIOB_28, else use P8_2.

config RTL87X3G_USE_P10_0_AS_GPIOB29
	bool "Use P10_0 as GPIOB_29"
	default n
	help
	  If true, use P10_0 as GPIOB_29, else use P8_3.

config RTL87X3G_USE_P10_1_AS_GPIOB30
	bool "Use P10_1 as GPIOB_30"
	default n
	help
	  If true, use P10_1 as GPIOB_30, else use P8_4.

config RTL87X3G_USE_P10_2_AS_GPIOB31
	bool "Use P10_2 as GPIOB_31"
	default n
	help
	  If true, use P10_2 as GPIOB_31, else use P8_5.

endif # GPIO_RTL87X3G && SOC_SERIES_RTL87X3G
```

## drivers/i2c/Kconfig.rtl87x3g
```kconfig
# RTL87X3G i2c configuration

# Copyright(c) 2025, Realtek Semiconductor Corporation.
# SPDX-License-Identifier: Apache-2.0

config I2C_RTL87X3G
	bool "RTL87X3G I2C driver"
	default y
	depends on DT_HAS_REALTEK_RTL87X3G_I2C_ENABLED
	select USE_HAL_REALTEK_I2C
	help
	  Enable the RTL87X3G i2c driver.

if I2C_RTL87X3G

config I2C_RTL87X3G_INTERRUPT
	bool
	default n
	help
	  Do transfer with i2c interrupt.

endif
```

## drivers/input/Kconfig.rtl87x3g_kscan
```kconfig
# RTL87X3G kscan configuration

# Copyright(c) 2025, Realtek Semiconductor Corporation.
# SPDX-License-Identifier: Apache-2.0

config INPUT_RTL87X3G_KSCAN
	bool "RTL87X3G MCU kscan driver"
	default y
	depends on DT_HAS_REALTEK_RTL87X3G_INPUT_KSCAN_ENABLED
	select USE_HAL_REALTEK_KEYSCAN
	help
	  Enable the RTL87X3G kscan driver.

if INPUT_RTL87X3G_KSCAN
config RTL87X3G_INPUT_KSCAN_MAX_ROW_SIZE
	int "Max row size for RTL87X3G kscan"
	default 12
	help
	  Max row size for RTL87X3G kscan.

config RTL87X3G_INPUT_KSCAN_MAX_COL_SIZE
	int "Max column size for RTL87X3G kscan"
	default 20
	help
	  Max column size for RTL87X3G kscan.

config RTL87X3G_INPUT_KSCAN_GHOST_KEY_FILTER
	bool "Ghost key filter for RTL87X3G kscan"
	default y
	help
	  Ghost key filter for RTL87X3G kscan.

config RTL87X3G_INPUT_KSCAN_AUTOSCAN_MODE
	bool "Config scanmode for RTL87X3G kscan"
	default n
	help
	  Default is manual scan, else is auto scan.

endif # INPUT_RTL87X3G_KSCAN
```

## drivers/led/Kconfig.rtl87x3g
```kconfig
# RTL87X3G led configuration

# Copyright(c) 2025, Realtek Semiconductor Corporation.
# SPDX-License-Identifier: Apache-2.0

config LED_RTL87X3G
	bool "RTL87X3G MCU led driver"
	default y
	depends on DT_HAS_REALTEK_RTL87X3G_LED_ENABLED
	select USD_HAL_REALTEK_SLEEP_LED
	help
	  Enable the RTL87X3G led driver.
	  The controller and the driver support two hardware configurations:
	   - one three-channel (RGB) LED
	   - or three single-channel LEDs
```

## drivers/pinctrl/Kconfig.rtl87x3g
```kconfig
# RTL87X3G PINCTRL configuration

# Copyright(c) 2025, Realtek Semiconductor Corporation.
# SPDX-License-Identifier: Apache-2.0

config PINCTRL_RTL87X3G
	bool "RTL87X3G pin controller driver"
	default y
	depends on DT_HAS_REALTEK_RTL87X3G_PINCTRL_ENABLED
	select USE_HAL_REALTEK_PINMUX
	help
	  Enable the RTL87X3G pin controller driver.
```

## drivers/pwm/Kconfig.rtl87x3g
```kconfig
# RTL87X3G pwm configuration

# Copyright(c) 2025, Realtek Semiconductor Corporation.
# SPDX-License-Identifier: Apache-2.0

config PWM_RTL87X3G
	bool "RTL87X3G PWM driver"
	default y
	depends on DT_HAS_REALTEK_RTL87X3G_PWM_ENABLED
	select USE_HAL_REALTEK_TIM
	help
	  Enable the RTL87X3G pwm driver.

config LPPWM_RTL87X3G
	bool "RTL87X3G LPPWM driver"
	default y
	depends on DT_HAS_REALTEK_RTL87X3G_LPPWM_ENABLED
	select USE_HAL_REALTEK_LPPWM
	help
	  Enable the RTL87X3G low-power PWM (AON domain) driver.
```

## drivers/rtc/Kconfig.rtl87x3g
```kconfig
# RTL87X3G rtc configuration

# Copyright(c) 2025, Realtek Semiconductor Corporation.
# SPDX-License-Identifier: Apache-2.0

config RTC_RTL87X3G
	bool "RTL87X3G RTC driver"
	default n
	depends on DT_HAS_REALTEK_RTL87X3G_RTC_ENABLED
	select USE_HAL_REALTEK_RTC
	help
	  Enable the RTL87X3G rtc driver.
```

## drivers/sdhc/Kconfig.rtl87x3g
```kconfig
# RTL87X3G sdhc configuration

# Copyright(c) 2020, Realtek Semiconductor Corporation.
# SPDX-License-Identifier: Apache-2.0

config SDHC_RTL87X3G
	bool "RTL87X3G MCU serial driver"
	default y
	depends on DT_HAS_REALTEK_RTL87X3G_SDHC_ENABLED
	select USE_HAL_REALTEK_SDHC
	select SDHC_SUPPORTS_NATIVE_MODE

	help
	  Enable the RTL87X3G sdhc driver.

if SDHC_RTL87X3G
config SDHC_BUFFER_ALIGNMENT
	default 4

config SDHC_RTL87X3G_TUNING
	bool "Tuning during card initialization"
	default y
	help
	  Enable the RTL87X3G sdhc tuning.

config SDHC_RTL87X3G_READ_STATIC
	bool "Use static read alignment buffer"
	default n
	help
	  Use a dedicated static buffer for SD card read alignment instead of the
	  card internal buffer (card_buffer). The RTL87X3G SDHC requires aligned
	  read buffers, and in practice most callers pass unaligned buffers. The
	  card internal buffer is only 512 bytes (one block), so bouncing an
	  unaligned read through it splits a large transfer into many single-block
	  reads, which is slow. This static buffer holds
	  SDHC_RTL87X3G_READ_STATIC_BLOCKS blocks, so unaligned reads are split into
	  far fewer, larger transfers. Aligned buffers are still read into directly.
	  The trade-off is SDHC_RTL87X3G_READ_STATIC_BLOCKS * 512 bytes of extra RAM.

config SDHC_RTL87X3G_READ_STATIC_BLOCKS
	int "Number of blocks for static read buffer"
	range 1 64
	default 8
	depends on SDHC_RTL87X3G_READ_STATIC
	help
	  Number of blocks (512 bytes each) for the static read alignment buffer.
	  Larger values reduce the number of card read transfers for unaligned
	  reads (higher throughput) at the cost of RAM (N * 512 bytes). Requests
	  larger than this are automatically split into chunks of this size.
	  Minimum value is 1, maximum is 64.

endif
```

## drivers/sensor/qdec_rtl87x3g/Kconfig
```kconfig
# Copyright(c) 2025, Realtek Semiconductor Corporation.
# SPDX-License-Identifier: Apache-2.0

config QDEC_RTL87X3G
	bool "RTL87X3G MCU qdec driver"
	default y
	depends on DT_HAS_REALTEK_RTL87X3G_QDEC_ENABLED
	select USE_HAL_REALTEK_QDEC
	help
	  Enable support for qdec driver for RTL87X3G MCU series.

if QDEC_RTL87X3G

config RTL87X3G_QDEC_X_AXIS_ENABLE
	bool "Enable x axis for RTL87X3G qdec"
	default y
	help
	  If true, enable x aix for RTL87X3G qdec.

config RTL87X3G_QDEC_Y_AXIS_ENABLE
	bool "Enable y axis for RTL87X3G qdec"
	default n
	help
	  If true, enable y aix for RTL87X3G qdec.

config RTL87X3G_QDEC_Z_AXIS_ENABLE
	bool "Enable z axis for RTL87X3G qdec"
	default n
	help
	  If true, enable z aix for RTL87X3G qdec.

endif # QDEC_RTL87X3G
```
