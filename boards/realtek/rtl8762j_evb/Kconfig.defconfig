## drivers/spi/Kconfig.rtl87x3g
```kconfig
# RTL87X3G spi configuration

# Copyright(c) 2020, Realtek Semiconductor Corporation.
# SPDX-License-Identifier: Apache-2.0

config SPI_RTL87X3G
	bool "RTL87X3G SPI driver"
	default y
	depends on DT_HAS_REALTEK_RTL87X3G_SPI_ENABLED
	select USE_HAL_REALTEK_SPI
	help
	  Enables the RTL87X3G spi driver.

if SPI_RTL87X3G

config SPI_RTL87X3G_INTERRUPT
	bool "RTL87X3G MCU SPI Interrupt Support"
	default y if SPI_ASYNC
	default y if SPI_RTL87X3G_DMA
	help
	  Enable the interrupt driven mode for SPI instances

config SPI_RTL87X3G_DMA
	bool "RTL87X3G MCU SPI DMA Support"
	select DMA
	select SPI_RTL87X3G_INTERRUPT
	select USE_HAL_REALTEK_DMA
	help
	  Use the DMA for SPI transfer
	  that enable dma channels in their device tree node.

endif # SPI_RTL87X3G
```

## drivers/timer/Kconfig.realtek_grtc_timer
```kconfig
# Copyright (c) 2025 Realtek Semiconductor Corp.
# SPDX-License-Identifier: Apache-2.0

config REALTEK_GRTC_TIMER
	bool "Realtek GRTC timer"
	default y
	depends on DT_HAS_REALTEK_GRTC_TIMER_ENABLED
	select TICKLESS_CAPABLE
	select TIMER_HAS_64BIT_CYCLE_COUNTER
	help
	  This module implements a kernel device driver for the Realtek GRTC timer,
	  and provides the standard "system clock driver" interfaces.
```
