## dts/bindings/adc/realtek,rtl87x3g-adc.yaml
```yaml
# Copyright(c) 2025, Realtek Semiconductor Corporation.
# SPDX-License-Identifier: Apache-2.0

description: |
  RTL87X3G ADC.
  The RTL87X3G ADC has 8 channels. Pinctrl must be configured as "RTL87X3G_SW_MODE" while using ADC.
  ADC_0 to ADC_7 could be configured as ADC sampling pins, corresponding to ADC channel 0 to 7.

  Example of devicetree configuration.

  &adc {
    pinctrl-0 = <&adc_default>;
    pinctrl-names = "default";
    #address-cells = <1>;
    #size-cells = <0>;
    status = "okay";
    channel@0 {
        reg = <0>;
        zephyr,gain = "ADC_GAIN_1";
        zephyr,reference = "ADC_REF_INTERNAL";
        zephyr,acquisition-time = <ADC_ACQ_TIME_DEFAULT>;
        zephyr,resolution = <12>;
    };

    channel@1 {
        reg = <1>;
        zephyr,gain = "ADC_GAIN_1";
        zephyr,reference = "ADC_REF_INTERNAL";
        zephyr,acquisition-time = <ADC_ACQ_TIME_DEFAULT>;
        zephyr,resolution = <12>;
    };
  };

  &pinctrl {
    adc_default: adc_default {
        group1 {
            psels = <RTL87X3G_PSEL(SW_MODE, ADC_0, DIR_IN,DRV_LOW, PULL_NONE)>,
            <RTL87X3G_PSEL(SW_MODE, ADC_1, DIR_IN, DRV_LOW, PULL_NONE)>;
        };
    };
  };

compatible: "realtek,rtl87x3g-adc"

include: [adc-controller.yaml, pinctrl-device.yaml]

properties:
  reg:
    required: true

  clocks:
    required: true

  channels:
    type: int
    description: Number of external channels
    required: true

  interrupts:
    required: true

  "#io-channel-cells":
    const: 1

  pinctrl-0:
    required: true

  pinctrl-names:
    required: true

  is-bypass-mode:
    type: int
    default: 0
    description: |
      This is a channel map to configure bypass/divide mode for each adc channel.
      For example, configure 0x05 means channel0 and channel2 are configured as bypass mode,
      and other channels are configured as divide mode by default.
      In "divide mode" the ADC range is 0 to 3.3V.
      In "bypass mode" the ADC range is 0 to 0.9V.

io-channel-cells:
  - input
```

## dts/bindings/counter/realtek,rtl87x3g_timer.yaml
```yaml
# Copyright(c) 2025, Realtek Semiconductor Corporation.
# SPDX-License-Identifier: Apache-2.0

description: |
  RTL87X3G COUNTER TIMER.
  Each Timer is part of a Timer Group and the number of available Timers
  is SoC-dependent.
  RTL87X3G has 7 Timers available.

  In order to use one of the available timers on your application add
  a <board>.overlay file with contents as below

    &timer2 {
            status = "okay";
            prescaler = <1>;
    };

  From the above, setting 'status' is required while the prescaler is
  optional. Check below for more information on the prescaler.

compatible: "realtek,rtl87x3g-timer"

include: base.yaml

properties:
  reg:
    required: true

  interrupts:
    required: true

  clocks:
    required: true

  channels:
    required: true
    type: int

  port:
    required: true
    type: int

  channel:
    required: true
    type: int

  case:
    required: true
    type: int

  prescaler:
    description: |
      The prescaler value defines the factor by which the clock will be
      divided.
      RTL87X3G supports 1/2/4/8/16/32/40/64.

    type: int
    default: 1
    enum:
      - 1
      - 2
      - 4
      - 8
      - 16
      - 32
      - 40
      - 64
```

## dts/bindings/dma/realtek,rtl87x3g-dma.yaml
```yaml
# Copyright(c) 2024, Realtek Semiconductor Corporation.
# SPDX-License-Identifier: Apache-2.0

description: |
  RTL87X3G DMA controller

  channel: Select channel for data transmitting

  slot: Handshake index, ref to rtl_gdma_def.h

  config: A 32bit mask specifying the DMA channel configuration
    - bit 0-1:     Direction  (see dma.h)
                 - 0x0: MEMORY to MEMORY
                 - 0x1: MEMORY to PERIPH
                 - 0x2: PERIPH to MEMORY
                 - 0x3: PERIPH to PERIPH(reserved)

    - bit 2-3:     Source address increase
                 - 0x0: increment address between transfers
                 - 0x1: decrement address between transfers
                 - 0x2: no address increment between transfers
                 - 0x3: reserved

    - bit 4-5:     Destination address increase
                 - 0x0: increment address between transfers
                 - 0x1: decrement address between transfers
                 - 0x2: no address increment between transfers
                 - 0x3: reserved

    - bit 6-7:     Source data width
                 - 0x0: 8 bits
                 - 0x1: 16 bits
                 - 0x2: 32 bits
                 - 0x3: reserved

    - bit 8-9:     Destination data width
                 - 0x0: 8 bits
                 - 0x1: 16 bits
                 - 0x2: 32 bits
                 - 0x3: reserved

    - bit 10-12:   Source data msize,
                   RTL87X3G supports 1/4/8/16/32/64/128.
                 - 0x0: msize 1
                 - 0x1: msize 4
                 - 0x2: msize 8
                 - 0x3: msize 16
                 - 0x4: msize 32
                 - 0x5: msize 64
                 - 0x6: msize 128
                 - 0x7: msize 256

    - bit 13-15:   Destination data width
                   RTL87X3G supports 1/4/8/16/32/64/128.
                 - 0x0: msize 1
                 - 0x1: msize 4
                 - 0x2: msize 8
                 - 0x3: msize 16
                 - 0x4: msize 32
                 - 0x5: msize 64
                 - 0x6: msize 128
                 - 0x7: msize 256

    - bit 16-20:   Priority
                   RTL87X3G supports 0~15.
                 - 0 ~ 15 can be configured

  Example of devicetree configuration

  Include <zephyr/dt-bindings/dma/rtl87x3g-dma.h> and compose the slot and
  config cells from the named macros instead of writing raw numbers:

  #include <zephyr/dt-bindings/dma/rtl87x3g-dma.h>

  &uart2 {
        status = "okay";
        dmas = <&dma0 2 RTL87X3G_DMA_HANDSHAKE_UART2_RX
                        (RTL87X3G_DMA_P2M
                         | RTL87X3G_DMA_SRC_FIXED
                         | RTL87X3G_DMA_DST_INC
                         | RTL87X3G_DMA_SRC_WIDTH_8BIT
                         | RTL87X3G_DMA_DST_WIDTH_8BIT
                         | RTL87X3G_DMA_SRC_MSIZE(RTL87X3G_DMA_MSIZE_1)
                         | RTL87X3G_DMA_DST_MSIZE(RTL87X3G_DMA_MSIZE_1)
                         | RTL87X3G_DMA_PRIORITY(0))>,
               <&dma0 3 RTL87X3G_DMA_HANDSHAKE_UART2_TX
                        (RTL87X3G_DMA_M2P
                         | RTL87X3G_DMA_SRC_INC
                         | RTL87X3G_DMA_DST_FIXED
                         | RTL87X3G_DMA_SRC_WIDTH_8BIT
                         | RTL87X3G_DMA_DST_WIDTH_8BIT
                         | RTL87X3G_DMA_SRC_MSIZE(RTL87X3G_DMA_MSIZE_1)
                         | RTL87X3G_DMA_DST_MSIZE(RTL87X3G_DMA_MSIZE_1)
                         | RTL87X3G_DMA_PRIORITY(1))>;
        dma-names = "rx", "tx";
  };

  "uart2" uses dma0 for transmitting and receiving in the example.
  Each is named "rx" and "tx".
  The channel cell assigns channel 2 to receive and channel 3 to transmit.
  The slot cell configs specified handshake for different peripherals.
  The config cell can take various configs, composed from the RTL87X3G_DMA_*
  macros above; the raw bit layout is documented in the "config" field below.
  But the setting used depends on each driver implementation.
  Set the priority for the transmitting channel as HIGH, LOW(the default) for receive channel.

compatible: "realtek,rtl87x3g-dma"

include: dma-controller.yaml

properties:
  reg:
    required: true

  interrupts:
    required: true

  dma-channels:
    required: true

  clocks:
    required: true

  dma-port:
    type: int
    required: true

  "#dma-cells":
    const: 3

dma-cells:
  - channel
  - slot
  - config
```

## dts/bindings/flash_controller/realtek,rtl87x3g-nand-flash-controller.yaml
```yaml
description: RTL87x3G Series flash controller

compatible: "realtek,rtl87x3g-nand-flash-controller"

include: flash-controller.yaml
```

## dts/bindings/flash_controller/realtek,rtl87x3g-nor-flash-controller.yaml
```yaml
description: RTL87x3G Series flash nor controller

compatible: "realtek,rtl87x3g-nor-flash-controller"

include: flash-controller.yaml
```

## dts/bindings/gpio/realtek,rtl87x3g-gpio.yaml
```yaml
# Copyright(c) 2025, Realtek Semiconductor Corporation.
# SPDX-License-Identifier: Apache-2.0

description: |
  RTL87X3G GPIO.
  Note that some of different pins could be mapped to the same gpio number.

compatible: "realtek,rtl87x3g-gpio"

include: [gpio-controller.yaml, base.yaml]

properties:
  reg:
    required: true

  clocks:
    required: true

  "#gpio-cells":
    const: 2

  port:
    type: int
    required: true
    description: |
      The GPIO port number. 
      GPIO port GPIOA has:

        port = <0>;

      And GPIO port GPIOB has:

        port = <1>;

gpio-cells:
  - pin
  - flags
```

## dts/bindings/i2c/realtek,rtl87x3g-i2c.yaml
```yaml
# Copyright(c) 2025, Realtek Semiconductor Corporation.
# SPDX-License-Identifier: Apache-2.0

description: |
  RTL87X3G I2C.

compatible: "realtek,rtl87x3g-i2c"

include: [i2c-controller.yaml, reset-device.yaml, pinctrl-device.yaml]

properties:
  reg:
    required: true

  interrupts:
    required: true

  clocks:
    required: true

  pinctrl-0:
    required: true

  pinctrl-names:
    required: true
```

## dts/bindings/led/realtek,rtl87x3g-led.yaml
```yaml
# Copyright(c) 2024, Realtek Semiconductor Corporation.
# SPDX-License-Identifier: Apache-2.0

description: |
  RTL87X3G LED.

  The following example defines a single RGB LED in the sleep-led DT node

  &sleep-led {
    status = "okay";

    led_0 {
      label = "RGB LED";
      index = <0>;
      color-mapping =
        <LED_COLOR_ID_RED>,
        <LED_COLOR_ID_GREEN>,
        <LED_COLOR_ID_BLUE>;
        pinctrl-0 = <&rgb_led_default>;
        pinctrl-names = "default";
    };
  };

  &pinctrl {
    rgb_led_default: rgb_led_default {
      group1 {
        psels = <RTL87X3G_PSEL(LED0, P6_0, DIR_OUT, DRV_HIGH, PULL_NONE)>,
        <RTL87X3G_PSEL(LED1, P6_1, DIR_OUT, DRV_HIGH, PULL_NONE)>,
        <RTL87X3G_PSEL(LED2, P6_2, DIR_OUT, DRV_HIGH, PULL_NONE)>;
      };
  };

  The following example defines three single-channel LEDs in the sleep-led DT node

  &sleep-led {
    status = "okay";

    led_0 {
      label = "RED LED";
      index = <0>;
      color-mapping =
        <LED_COLOR_ID_RED>;
        pinctrl-0 = <&r_led_default>;
        pinctrl-names = "default";
    };

    led_1 {
      label = "GREEN LED";
      index = <1>;
      color-mapping =
        <LED_COLOR_ID_GREEN>;
        pinctrl-0 = <&g_led_default>;
        pinctrl-names = "default";
    };

    led_2 {
      label = "BLUE LED";
      index = <2>;
      color-mapping =
        <LED_COLOR_ID_BLUE>;
        pinctrl-0 = <&b_led_default>;
        pinctrl-names = "default";
    };
  };

  &pinctrl {
    r_led_default: r_led_default {
      group1 {
        psels = <RTL87X3G_PSEL(LED0, P6_0, DIR_OUT, DRV_HIGH, PULL_NONE)>;
      };
    g_led_default: g_led_default {
      group1 {
        psels = <RTL87X3G_PSEL(LED1, P6_1, DIR_OUT, DRV_HIGH, PULL_NONE)>;
      };
    b_led_default: b_led_default {
      group1 {
        psels = <RTL87X3G_PSEL(LED2, P6_2, DIR_OUT, DRV_HIGH, PULL_NONE)>;
      };
  };

compatible: "realtek,rtl87x3g-led"

include: [led-controller.yaml, base.yaml]

properties:
  reg:
    required: true

child-binding:
  include: [pinctrl-device.yaml]

  properties:
    label:
      required: true

    index:
      required: true

    color-mapping:
      required: true

    pinctrl-0:
      required: true

    pinctrl-names:
      required: true

    active-low:
      type: boolean
      description: low level is active

    prescale:
      type: int
      default: 1
      description: |
        Prescale for sleep led, the source clock is 32kHz.
        Can be set from 1 to 1024.

    frequency-hz:
      type: int
      default: 500
      description: |
        Output frequency to set brightness.
```

## dts/bindings/misc/realtek,nand-flash-disk.yaml
```yaml
# Copyright (c) 2022 Nordic Semiconductor ASA
# Copyright (c) 2025 Realtek Semiconductor Corporation.
# SPDX-License-Identifier: Apache-2.0

description: Block storage device on NAND flash partition

compatible: "realtek,nand-flash-disk"

include: base.yaml

properties:

  disk-name:
    type: string
    required: true
    description: |
      Disk name.
  
  disk-size:
    type: int
    required: true
    description: |
      Disk size in bytes.

  block-size:
    type: int
    required: true
    description: |
      Emulated block device block size in bytes.

  page-size:
    type: int
    default: 2048
    description: |
      Emulated block device page size in bytes.
```

## dts/bindings/nftl/realtek,nftl.yaml
```yaml
# Copyright(c) 2025, Realtek Semiconductor Corporation.
# SPDX-License-Identifier: Apache-2.0

description: Realtek FTL for nand flash


compatible: "realtek,nftl"

include: ["base.yaml"]

properties:

  size:
    type: int
    required: true
    description: |
      nftl size in bytes.
```

## dts/bindings/pwm/realtek,rtl87x3g-lppwm.yaml
```yaml
# Copyright(c) 2025, Realtek Semiconductor Corporation.
# SPDX-License-Identifier: Apache-2.0

description: RTL87X3G LPPWM (Low Power PWM, AON domain)

compatible: "realtek,rtl87x3g-lppwm"

include: [base.yaml, pwm-controller.yaml, pinctrl-device.yaml]

properties:
  pinctrl-0:
    required: true

  pinctrl-names:
    required: true

  "#pwm-cells":
    const: 3

  src-clk-freq:
    type: int
    description: |
      Frequency of LPPWM source clock. Default is 32000, can be 32768 if
      using external crystal or different AON clock configuration.
    enum:
      - 32000
      - 32768

pwm-cells:
  - channel
  - period
  - flags
```

## dts/bindings/pwm/realtek,rtl87x3g-pwm.yaml
```yaml
# Copyright(c) 2025, Realtek Semiconductor Corporation.
# SPDX-License-Identifier: Apache-2.0

description: RTL87X3G PWM

compatible: "realtek,rtl87x3g-pwm"

include: [base.yaml, pwm-controller.yaml, pinctrl-device.yaml]

properties:
  pinctrl-0:
    required: true

  pinctrl-names:
    required: true

  clocks:
    required: false

  "#pwm-cells":
    const: 3

pwm-cells:
  - channel
  - period
  - flags
```

## dts/bindings/serial/realtek,rtl87x3g-uart.yaml
```yaml
# Copyright(c) 2025, Realtek Semiconductor Corporation.
# SPDX-License-Identifier: Apache-2.0

description: |
  RTL87X3G UART.

compatible: "realtek,rtl87x3g-uart"

include: [uart-controller.yaml, base.yaml, pinctrl-device.yaml]

bus: uart

properties:
  reg:
    required: true

  clocks:
    required: true

  interrupts:
    required: true

  pinctrl-0:
    required: true

  pinctrl-names:
    required: true

  flow-ctrl:
    type: boolean
    description: |
      Enable cts and rts or not.

  one-wire:
    type: boolean
    description: |
      Enable one-wire uart or not.
```

## dts/bindings/spi/realtek,rtl87x3g-spi.yaml
```yaml
# Copyright(c) 2025, Realtek Semiconductor Corporation.
# SPDX-License-Identifier: Apache-2.0

description: RTL87X3G SPI

compatible: "realtek,rtl87x3g-spi"

include: [spi-controller.yaml, reset-device.yaml, pinctrl-device.yaml]

properties:
  reg:
    required: true

  interrupts:
    required: true

  clocks:
    required: true

  pinctrl-0:
    required: true

  pinctrl-names:
    required: true

  rx-sample-delay:
    type: int
    description: |
      Sample delay on spi miso/mosi line. This parameter can be 0 to 255.

  is-slave:
    type: boolean
    description: Indicate the spi is spi slave.

  max-bus-freq:
    type: int
    default: 400000
    description: |
      Maximum bus frequency for SPI bus.
```
