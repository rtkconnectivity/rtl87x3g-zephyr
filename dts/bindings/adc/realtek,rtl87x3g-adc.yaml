## dts/bindings/usb/realtek,rtl8773g-udc.yaml
```yaml
# Copyright(c) 2024, Realtek Semiconductor Corporation.
# SPDX-License-Identifier: Apache-2.0

description: |
  RTL8773G USB device controller.

compatible: "realtek,rtl8773g-udc"

include: ["snps,dwc2.yaml", pinctrl-device.yaml]

properties:
  reg:
    required: true

  interrupts:
    required: true
```

## soc/realtek/bee/rtl8762j/Kconfig
```kconfig
# Copyright (c) 2024 Realtek Semiconductor Corp.
# SPDX-License-Identifier: Apache-2.0
config SOC_SERIES_RTL8762J
	select ARM
	select CPU_CORTEX_M33
	select CPU_HAS_FPU
	select CPU_HAS_ARM_MPU
	select DYNAMIC_INTERRUPTS
	select ARMV8_M_DSP
	select XIP
	select MULTI_HEAP
	select POLL#osif task signal
	select SYS_HEAP_RUNTIME_STATS#osif mem
	select THREAD_STACK_INFO#osif dlps
```

## soc/realtek/bee/rtl8762j/Kconfig.defconfig.series
```kconfig
# Copyright (c) 2024 Realtek Semiconductor Corp.
# SPDX-License-Identifier: Apache-2.0
if SOC_SERIES_RTL8762J
config SOC_SERIES
	default "rtl8762j"

config SOC_PART_NUMBER
	default "rtl8762jx" if SOC_PART_NUMBER_RTL8762JX

config NUM_IRQS
	int
	default 91

# config CODE_DATA_RELOCATION
# 	default y

config USE_DT_CODE_PARTITION
	default y

config FPU
	default y if CPU_HAS_FPU

config CORTEX_M_SYSTICK
	default n if REALTEK_GRTC_TIMER

config SYS_CLOCK_HW_CYCLES_PER_SEC
	int
	default 40000000 if CORTEX_M_SYSTICK
	default 32000 if REALTEK_GRTC_TIMER

config SYS_CLOCK_TICKS_PER_SEC
	int
	default 100 if CORTEX_M_SYSTICK #10ms/1tick
	default 1000 if REALTEK_GRTC_TIMER #1ms/1tick

config TICKLESS_KERNEL
	default y

config TIMESLICE_SIZE
	default 10

config INIT_STACKS
	default y

config SOC_SERIES
	default "rtl8762j"

config IDLE_STACK_SIZE
	default 1024 if REALTEK_BEE_PM

config RUNTIME_NMI
	default y

# config COOP_ENABLED
# 	default n

# rsource "Kconfig.defconfig.rtl87*"
# rsource "osif/Kconfig"

endif # SOC_SERIES_RTL8762J
```

## soc/realtek/bee/rtl8762j/Kconfig.soc
```kconfig
# Copyright (c) 2024 Realtek Semiconductor Corp.
# SPDX-License-Identifier: Apache-2.0
config SOC_SERIES_RTL8762J
	bool
	select SOC_FAMILY_REALTEK_BEE
	help
	  Enable support for Realtek RTL8762J series

config SOC_RTL8762JX
	bool
	select SOC_SERIES_RTL8762J

config SOC
	default "rtl8762jx" if SOC_RTL8762JX

config SOC_PART_NUMBER_RTL8762JX
	bool
```

## soc/realtek/bee/rtl8762j/osif/Kconfig
```kconfig
# Copyright (c) 2024 Realtek Semiconductor Corp.
# SPDX-License-Identifier: Apache-2.0

config REALTEK_OSIF
	bool "REALTEK OSIF API"
	default y
	depends on THREAD_STACK_INFO
	depends on POLL
	depends on SYS_HEAP_RUNTIME_STATS
	depends on RUNTIME_NMI
	help
	  This enables REALTEK OSIF API support. This is an OS-integration
	  layer which allows applications using REALTEK OSIF APIs to build on
	  Zephyr.

if REALTEK_OSIF

config OSIF_TIMER_MAX_COUNT
	int "Maximum timer count in OSIF application"
	default 64
	range 0 $(UINT8_MAX)
	help
	  Mention maximum number of timers in OSIF compliant application.

config OSIF_TASK_MAX_COUNT
	int "Maximum task count in OSIF application"
	default 10
	range 0 $(UINT8_MAX)
	help
	  Mention maximum number of tasks in OSIF compliant application.
endif
```

## soc/realtek/bee/rtl87x3g/Kconfig
```kconfig
# Copyright (c) 2024 Realtek Semiconductor Corp.
# SPDX-License-Identifier: Apache-2.0
config SOC_SERIES_RTL87X3G
	select ARM
	select CPU_CORTEX_M55
	select CPU_HAS_FPU
	select CPU_HAS_ARM_MPU
	select DYNAMIC_INTERRUPTS
	select ARMV8_M_DSP
	select ARMV8_1_M_MVEI
	select ARMV8_1_M_MVEF
	select XIP
	select MULTI_HEAP
	select POLL#osif task signal
	select SYS_HEAP_RUNTIME_STATS#osif mem
	select THREAD_STACK_INFO#osif dlps
	select HAS_PM
	select PLATFORM_SPECIFIC_INIT
	select THREAD_NAME
```

## soc/realtek/bee/rtl87x3g/Kconfig.defconfig.series
```kconfig
# Copyright (c) 2024 Realtek Semiconductor Corp.
# SPDX-License-Identifier: Apache-2.0
if SOC_SERIES_RTL87X3G
config SOC_SERIES
	default "rtl87x3g"

config SOC_PART_NUMBER
	default "rtl8773gtp" if SOC_PART_NUMBER_RTL8773GTP
	default "rtl8783gbf" if SOC_PART_NUMBER_RTL8783GBF
	default "rtl8763gws" if SOC_PART_NUMBER_RTL8763GWS
	default "rtl8763gts" if SOC_PART_NUMBER_RTL8763GTS

config NUM_IRQS
	int
	default 116

config CODE_DATA_RELOCATION
	default y

config USE_DT_CODE_PARTITION
	default y

config FPU
	default y if CPU_HAS_FPU

config SYS_CLOCK_HW_CYCLES_PER_SEC
	int
	default 32000

config SYS_CLOCK_TICKS_PER_SEC
	int
	default 100 #10ms/1tick

config TICKLESS_KERNEL
	default n

config TIMESLICE_SIZE
	default 10

config INIT_STACKS
	default y

config IDLE_STACK_SIZE
	default 1024

config RUNTIME_NMI
	default y

config NUM_COOP_PRIORITIES
	default 0 if !TEST

if PM
config PM_DEVICE
	default y

config REALTEK_PM_WAKEUP_REASON_GET
	bool "Enable to get wakeup reason after wakeup from deep sleep."
	select LOG
	default n
endif

choice
	prompt "DSP Share RAM Size options"
	default DSP_SHARE_RAM_80K
	depends on PLATFORM_SPECIFIC_INIT

config DSP_SHARE_RAM_80K
	bool "SHARE 80K RAM from DSP to MCU."

config DSP_SHARE_RAM_160K
	bool "SHARE 160K RAM from DSP to MCU."

config DSP_SHARE_RAM_208K
	bool "SHARE 208K RAM from DSP to MCU."

config DSP_SHARE_RAM_448K
	bool "SHARE 448K RAM from DSP to MCU."

endchoice

#to disable zephyr logging thread and use rtk logging mechanism

config LOG_RTK
	bool "Retarget from zephyr logging system to RTK log system"
	depends on LOG && !UART_CONSOLE && !SHELL
	select LOG_OUTPUT
	default y

if LOG_RTK

config LOG_PROCESS_THREAD
	default n

endif

# rsource "Kconfig.defconfig.rtl87*"
rsource "osif/Kconfig"

endif # SOC_SERIES_RTL87X3G
```

## soc/realtek/bee/rtl87x3g/Kconfig.soc
```kconfig
# Copyright (c) 2024 Realtek Semiconductor Corp.
# SPDX-License-Identifier: Apache-2.0
config SOC_SERIES_RTL87X3G
	bool
	select SOC_FAMILY_REALTEK_BEE
	help
	  Enable support for Realtek RTL87X3G series

config SOC_RTL8773GTP
	bool
	select SOC_SERIES_RTL87X3G

config SOC_RTL8783GBF
	bool
	select SOC_SERIES_RTL87X3G
	
config SOC_RTL8763GWS
	bool
	select SOC_SERIES_RTL87X3G

config SOC_RTL8763GTS
	bool
	select SOC_SERIES_RTL87X3G

config SOC
	default "rtl8773gtp" if SOC_RTL8773GTP
	default "rtl8783gbf" if SOC_RTL8783GBF
	default "rtl8763gws" if SOC_RTL8763GWS
	default "rtl8763gts" if SOC_RTL8763GTS

config SOC_PART_NUMBER_RTL8773GTP
	bool

config SOC_PART_NUMBER_RTL8783GBF
	bool
	
config SOC_PART_NUMBER_RTL8763GWS
	bool

config SOC_PART_NUMBER_RTL8763GTS
	bool

config SOC_NAND_BOOT
	bool 
	default n
```

## subsys/fs/romfs/Kconfig
```kconfig
config FILE_SYSTEM_ROMFS
    bool "ROMFS file system"
    depends on SOC_SERIES_RTL87X3G
    default n
    help
      Enable ROMFS file system.

config FS_ROMFS_NUM_FILES
    int "ROMFS number of files"
    depends on FILE_SYSTEM_ROMFS
    default 4
    help
      Number of files that can be opened simultaneously.
```

## tests/drivers/disk/disk_access/Kconfig
```kconfig
# SPDX-License-Identifier: Apache-2.0
# Copyright 2022 NXP

mainmenu "Disk driver access test"

config MAIN_STACK_SIZE
	default 1280 if (MMC_STACK && IMX_USDHC)

config DISK_ACCESS_STRESS
	bool "Endless read/write stress test"
	help
	  Add a non-terminating read/write/verify stress test item that keeps
	  running on errors instead of aborting, to continuously exercise the
	  disk driver (and its error-recovery path) on real hardware.

config DISK_ACCESS_TEST_ERASE
	bool "Erase test items (test_erase / test_erase_full)"
	help
	  Add the Realtek-specific erase test items that verify a physical erase
	  actually happened. Destructive and hardware-specific, so off by default:
	  a plain "west build" then runs only the native Zephyr test items.

config DISK_ACCESS_TEST_POWER_CYCLE
	bool "Power-cycle test item (test_power_cycle)"
	help
	  Add the Realtek-specific power-cycle test item that toggles the disk
	  through CTRL_DEINIT/CTRL_INIT many times. Hardware-specific, so off by
	  default: a plain "west build" then runs only the native Zephyr test
	  items.

config DISK_ACCESS_TEST_FS_FORMAT
	bool "FatFs format test item (test_fs_format)"
	select FILE_SYSTEM
	select FAT_FILESYSTEM_ELM
	select FILE_SYSTEM_MKFS
	select FS_FATFS_USE_TRIM
	help
	  Add the Realtek-specific FatFs format test item that formats the eMMC
	  with fs_mkfs(), mounts it, writes and reads back a file, then unmounts.
	  Destructive and hardware-specific, so off by default: a plain
	  "west build" then runs only the native Zephyr test items.

source "Kconfig.zephyr"
```

## tests/drivers/disk/disk_access/boards/rtl87x3g_evb_sdmmc.conf
```kconfig
CONFIG_GPIO=y
CONFIG_HEAP_MEM_POOL_SIZE=512
CONFIG_MAIN_STACK_SIZE=4096
CONFIG_TEST_EXTRA_STACK_SIZE=4096
```
