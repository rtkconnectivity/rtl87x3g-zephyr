## CMakeLists.txt
```
# SPDX-License-Identifier: Apache-2.0

cmake_minimum_required(VERSION 3.20.0)
find_package(Zephyr REQUIRED HINTS $ENV{ZEPHYR_BASE})
project(realtek_osif)

target_include_directories(app PRIVATE ${ZEPHYR_BASE}/include/zephyr/portability)
FILE(GLOB app_sources src/*.c)
target_sources(app PRIVATE ${app_sources})
```

## prj.conf
```kconfig
CONFIG_ZTEST=y
CONFIG_THREAD_CUSTOM_DATA=y
CONFIG_POLL=y
CONFIG_REALTEK_OSIF=y
CONFIG_SYS_HEAP_RUNTIME_STATS=y
CONFIG_IRQ_OFFLOAD=y
CONFIG_ASSERT=y
```

## src/osif_mem.c
```c
#include <zephyr/kernel.h>
#include <zephyr/ztest.h>
#include <stdlib.h>
#include <errno.h>
#include <time.h>
#include <stdint.h>
#include <os_mem.h>
#include <trace.h>

#define TOO_BIG PTRDIFF_MAX

#define BUF_LEN 10

/* The access test allocates objects of this type and dereferences members. */
union aligntest {
	long long       thelonglong;
	double          thedouble;
	uintmax_t       theuintmax_t;
	void            (*thepfunc)(void);
	time_t          thetime_t;
};

/* Make sure we can access some built-in types. */
static void do_the_access(volatile union aligntest *aptr)
{
	aptr->thelonglong = 2;
	aptr->thelonglong;

	if (IS_ENABLED(CONFIG_FPU)) {
		aptr->thedouble = 3.0;
		aptr->thedouble;
	}

	aptr->theuintmax_t = 4;
	aptr->theuintmax_t;

	aptr->thepfunc = test_main;
	aptr->thepfunc;

	aptr->thetime_t = 3;
	aptr->thetime_t;
}

#define PRINT_TYPE_INFO(_t) \
	TC_PRINT("    %-14s  %4zu  %5zu\n", #_t, sizeof(_t), __alignof__(_t))

ZTEST(osif_mem, test_align_access)
{
	char *ptr[64] = { NULL };

	TC_PRINT("  Compiler type info for " CONFIG_ARCH " " CONFIG_BOARD "\n");
	TC_PRINT("    TYPE            SIZE  ALIGN\n");
	PRINT_TYPE_INFO(int);
	PRINT_TYPE_INFO(long);
	PRINT_TYPE_INFO(long long);
	PRINT_TYPE_INFO(double);
	PRINT_TYPE_INFO(size_t);
	PRINT_TYPE_INFO(void *);
	PRINT_TYPE_INFO(void (*)(void));
	PRINT_TYPE_INFO(time_t);

	/* Tries to use the os_mem_alloc( implementation when in different states. */
	for (size_t i = 0; i < ARRAY_SIZE(ptr); i++) {
		union aligntest *aptr = NULL;

		ptr[i] = os_mem_alloc(RAM_TYPE_DATA_ON, sizeof *(ptr[i]));
		aptr = os_mem_alloc(RAM_TYPE_DATA_ON, sizeof(*aptr));
		if (aptr) {
			do_the_access(aptr);
		}
		os_mem_free(aptr);
	}
	for (size_t i = 0; i < ARRAY_SIZE(ptr); i++) {
		os_mem_free(ptr[i]);
		ptr[i] = NULL;
	}

	for (size_t n = 0; n < ARRAY_SIZE(ptr); n++) {
		union aligntest *aptr = NULL;

		for (size_t i = 0; i < n; i++) {
			ptr[i] = os_mem_alloc(RAM_TYPE_DATA_ON, sizeof *(ptr[i]));
		}
		aptr = os_mem_alloc(RAM_TYPE_DATA_ON, sizeof(*aptr));
		if (aptr) {
			do_the_access(aptr);
		}
		os_mem_free(aptr);
		for (size_t i = 0; i < n; i++) {
			os_mem_free(ptr[i]);
			ptr[i] = NULL;
		}
	}

	for (size_t n = 0; n < ARRAY_SIZE(ptr); n++) {
		union aligntest *aptr = NULL;

		ptr[n] = os_mem_alloc(RAM_TYPE_DATA_ON, n);
		aptr = os_mem_alloc(RAM_TYPE_DATA_ON, sizeof(*aptr));
		if (aptr) {
			do_the_access(aptr);
		}
		os_mem_free(aptr);
		os_mem_free(ptr[n]);
		ptr[n] = NULL;
	}
}

/**
 * @brief Test dynamic memory allocation using os_mem_alloc.
 *
 * @see os_mem_alloc_intern_zephyr()
 */
ZTEST(osif_mem, test_os_mem_alloc)
{
	/* Initialize error number to avoid garbage value, in case of SUCCESS */
	int *iptr = NULL;

	/* Basic alloc and free testing. */
	iptr = os_mem_alloc(RAM_TYPE_DATA_ON, BUF_LEN * sizeof(int));
	zassert_not_null((iptr), "os_mem_alloc failed, type RAM_TYPE_DATA_ON, errno: %d", errno);
	memset(iptr, 'p', BUF_LEN * sizeof(int));
	os_mem_free(iptr);
	iptr = NULL;

    iptr = os_mem_alloc(RAM_TYPE_BUFFER_ON, BUF_LEN * sizeof(int));
	zassert_not_null((iptr), "os_mem_alloc failed, type RAM_TYPE_BUFFER_ON errno: %d", errno);
	memset(iptr, 'p', BUF_LEN * sizeof(int));
	os_mem_free(iptr);
	iptr = NULL;

	/* Alloc a memory that is too big */

 	iptr = os_mem_alloc(RAM_TYPE_DATA_ON, DT_REG_SIZE(DT_NODELABEL(heap_itcm)));
	zassert_is_null((iptr), "os_mem_alloc passed unexpectedly");

    uint32_t heap_itcm_free_size =  os_mem_peek(RAM_TYPE_ITCM);

	/* Test the heap allocate Strategy: first heap_itcm, then heap_dtcm and finally heap_sram. */
    iptr = os_mem_alloc(RAM_TYPE_DATA_ON, heap_itcm_free_size);
	zassert_not_null((iptr), "os_mem_alloc failed with maxiumn size, type RAM_TYPE_DATA_ON, errno: %d", errno);
    zassert_true((uint32_t)iptr >= (DT_REG_ADDR(DT_NODELABEL(heap_itcm)) &&
     (uint32_t)iptr <= (DT_REG_ADDR(DT_NODELABEL(heap_itcm))+DT_REG_SIZE(DT_NODELABEL(heap_itcm)))),
     "Address out of expected heap_itcm region");

    uint32_t heap_dtcm_free_size =  os_mem_peek(RAM_TYPE_DTCM);
    int *iptr2 = NULL;

    iptr2 = os_mem_alloc(RAM_TYPE_DATA_ON, heap_dtcm_free_size);
	zassert_not_null((iptr2), "os_mem_alloc failed with maxiumn size, type RAM_TYPE_DATA_ON, errno: %d", errno);
    zassert_true((uint32_t)iptr2 >= (DT_REG_ADDR(DT_NODELABEL(heap_dtcm)) &&
     (uint32_t)iptr2 <= (DT_REG_ADDR(DT_NODELABEL(heap_dtcm))+DT_REG_SIZE(DT_NODELABEL(heap_dtcm)))),
     "Address out of expected heap_dtcm region");

    uint32_t heap_sram_free_size =  os_mem_peek(RAM_TYPE_DATA_ON);
    int *iptr3 = NULL;

    iptr3 = os_mem_alloc(RAM_TYPE_DATA_ON, heap_sram_free_size);
	zassert_not_null((iptr3), "os_mem_alloc failed with maxiumn size, type RAM_TYPE_DATA_ON, errno: %d", errno);
    zassert_true((uint32_t)iptr3 >= (DT_REG_ADDR(DT_NODELABEL(heap_sram)) &&
     (uint32_t)iptr3 <= (DT_REG_ADDR(DT_NODELABEL(heap_sram))+DT_REG_SIZE(DT_NODELABEL(heap_sram)))),
     "Address out of expected heap_sram region");

	os_mem_free(iptr);
	os_mem_free(iptr2);
	os_mem_free(iptr3);
	iptr = NULL;
	iptr2 = NULL;
	iptr3 = NULL;
}


/**
 * @brief Test dynamic memory allocation using os_mem_alloc.
 *
 * @see os_mem_alloc_intern_zephyr()
 */
ZTEST(osif_mem, test_os_mem_peek)
{
    size_t p_size;
    p_size = os_mem_peek(RAM_TYPE_DATA_ON);
}


/**
 * @brief Test dynamic memory free function using os_mem_free.
 *
 * @see os_mem_free()
 */
ZTEST(osif_mem, test_os_mem_free)
{
/*
 * In os_mem_free, if ptr is passed as NULL, no operation is performed
 * Just make sure, no exception occurs and test pass
 */
	os_mem_free(NULL);
    os_mem_aligned_free(NULL);
}

/**
 * @brief Test dynamic memory allocation function using os_mem_zalloc.
 *
 * @see os_mem_zalloc()
 */
ZTEST(osif_mem, test_os_mem_zalloc)
{
	/* Initialize error number to avoid garbage value, in case of SUCCESS */
	int *iptr = NULL;

	/* Basic alloc and free testing. */
	iptr = os_mem_zalloc(RAM_TYPE_DATA_ON, BUF_LEN * sizeof(int));
	zassert_not_null((iptr), "os_mem_zalloc failed, type RAM_TYPE_DATA_ON, errno: %d", errno);
	memset(iptr, 'p', BUF_LEN * sizeof(int));
	os_mem_free(iptr);
	iptr = NULL;

	iptr = os_mem_zalloc(RAM_TYPE_DATA_ON, BUF_LEN * sizeof(int));
	zassert_not_null((iptr), "os_mem_zalloc failed, type RAM_TYPE_DATA_ON, errno: %d", errno);
	zassert_true((*iptr == 0 && *(iptr+BUF_LEN-1) == 0),
	"os_mem_zalloc failed, the value in the alloced region is not zero! *iptr:%d, *(iptr+BUF_LEN-1) %d",
	*iptr, *(iptr+BUF_LEN-1));
	os_mem_free(iptr);
	iptr = NULL;
}

#define MAX_LEN (10 * BUF_LEN)

/**
 *
 * @brief Test dynamic memory allocation upto maximum size
 * Negative test case
 *
 */
__no_optimization void _test_memalloc_max(void)
{
	char *ptr = NULL;

	ptr = os_mem_alloc(RAM_TYPE_DATA_ON, TOO_BIG);
	zassert_is_null(ptr, "malloc passed unexpectedly");
	os_mem_free(ptr);
	ptr = NULL;
}

ZTEST(osif_mem, test_memalloc_max)
{
	_test_memalloc_max();
}

ZTEST_SUITE(osif_mem, NULL, NULL, NULL, NULL, NULL);
```

## src/osif_msgq.c
```c
#include <zephyr/ztest.h>
#include <zephyr/kernel.h>
#include <os_task.h>
#include <os_msg.h>
#include <os_sched.h>

struct sample_data {
	int data1;
	unsigned char data2;
	unsigned int data3;
};

#define MESSAGE1        512
#define MESSAGE2        123456
#define TIMEOUT_MS   500
#define Q_LEN           5
#define STACKSZ         1024

void *msgq_id;

void send_msg_thread(void *argument)
{
	int i;
	bool status;
	uint32_t msg_num;
	struct sample_data sample;
	struct sample_data data[Q_LEN] = { { 0 } };

	/* Wait for message_recv to complete initial checks */
	os_delay(TIMEOUT_MS);

	/* Prepare and send the 1st message (a simple integer data) */
	sample.data1 = MESSAGE1;
	status = os_msg_send(msgq_id, &sample, 0xFFFFFFFF);
	zassert_true(status == true, "os_msg_send failure for Message1");

	status = os_msg_queue_peek(msgq_id, &msg_num);
	zassert_true(status == true, 
		      "Something's wrong with os_msg_queue_peek!");

	/* The Queue should be empty at this point */
	zassert_equal(msg_num, 0,
		      "The msg_num is not 0 unexpectedly!");

	/* Fill the queue with blocks of messages */
	for (i = 0; i < Q_LEN; i++) {
		data[i].data1 = i * 3;
		data[i].data2 = i * 3 + 1;
		data[i].data3 = i * 3 + 2;
		status = os_msg_send(msgq_id, data + i, 0xFFFFFFFF);
		zassert_true(status == true,
			     "os_msg_send failure for message!");
	}

	status = os_msg_queue_peek(msgq_id, &msg_num);
	zassert_true(status == true, 
		      "Something's wrong with os_msg_queue_peek!");

	/* The Queue should be full at this point */
	zassert_equal(msg_num, Q_LEN,
		      "The msg_num is not FULL unexpectedly!");

	/* Try putting message to a full queue immediately
	 * before it is emptied out and assert failure
	 */
	sample.data1 = MESSAGE2;
	status = os_msg_send(msgq_id, &sample, 0);
	zassert_true(status == false,
		     "Something's wrong with os_msg_send. Sending msg to a full queue unexpectedly succeeded!");

	/* Try putting message to a full queue within a duration
	 * less than TIMEOUT_TICKS, before the queue is emptied out
	 */
	sample.data1 = MESSAGE2;
	status = os_msg_send(msgq_id, &sample, TIMEOUT_MS / 2);
	zassert_true(status == false,
		     "Something's wrong with os_msg_send. Sending msg to a full queue unexpectedly succeeded!");

	/* Send another message after the queue is emptied */
	sample.data1 = MESSAGE2;
	status = os_msg_send(msgq_id, &sample, TIMEOUT_MS * 2);
	zassert_true(status == true,
		     "os_msg_send failure for message!");
}

void  message_recv(void)
{
	int i;
	bool status;
	struct sample_data recv_data;

	/* Try getting message immediately before the queue is populated */
	status = os_msg_recv(msgq_id, (void *)&recv_data, 0);
	zassert_true(status == false,
		     "Something's wrong with os_msg_recv!");

	/* Try receiving message within a duration of TIMEOUT */
	status = os_msg_recv(msgq_id, (void *)&recv_data, TIMEOUT_MS);
	zassert_true(status == false,
		     "Something's wrong with os_msg_recv!");

	/* Receive 1st message */
	status = os_msg_recv(msgq_id, (void *)&recv_data, 0xFFFFFFFF);
	zassert_true(status == true, "os_msg_recv failure");
	zassert_equal(recv_data.data1, MESSAGE1);

	/* Wait for queue to get filled */
	os_delay(TIMEOUT_MS);

	/* Empty the queue */
	for (i = 0; i < Q_LEN; i++) {
		status = os_msg_recv(msgq_id, (void *)&recv_data, 0xFFFFFFFF);
		zassert_true(status == true, "os_msg_recv failure");

		zassert_equal(recv_data.data1, i * 3);
		zassert_equal(recv_data.data2, i * 3 + 1);
		zassert_equal(recv_data.data3, i * 3 + 2);
	}

	/* Receive the next message */
	status = os_msg_recv(msgq_id, (void *)&recv_data, 0xFFFFFFFF);
	zassert_true(status == true, "os_msg_recv failure");
	zassert_equal(recv_data.data1, MESSAGE2);
}

ZTEST(osif_msgq, test_messageq)
{
	bool status;
	struct sample_data sample;
	void *tid;
	uint32_t task_param;
	uint32_t msg_num;

	status = os_msg_queue_create(&msgq_id, "TestMsgQ", Q_LEN, sizeof(struct sample_data));
	zassert_true(status != false, "Message Queue creation failed");

	status = os_task_create(&tid, "send_thread", send_msg_thread,
                        &task_param, STACKSZ, 3);
	zassert_true(status != false, "Failed creating thread3");

	message_recv();

	/* Wait for the send_msg_thread to terminate before this thread
	 * terminates.
	 */
	os_delay(TIMEOUT_MS / 10);

	/* Make sure msgq is empty */
	status = os_msg_queue_peek(msgq_id, &msg_num);
	/* The Queue should be empty at this point */
	zassert_equal(msg_num, 0,
		      "The msg_num is not 0 unexpectedly!");

	sample.data1 = MESSAGE1;
	status = os_msg_send(msgq_id, &sample, 0xFFFFFFFF);//no recv waiting， No task waiting，so return success immediately.
	zassert_true(status == true, "os_msg_send failure for Message1");

	status = os_msg_queue_peek(msgq_id, &msg_num);
	/* The Queue should be empty at this point */
	zassert_equal(msg_num, 1,
		      "The msg_num is not 1 unexpectedly!");

	status = os_msg_queue_delete(msgq_id);
	zassert_true(status == true, "os_msg_queue_delete failure");

	status = os_task_delete(tid);
	zassert_true(status == true, "Error deleting TestMsgQ task");
}
ZTEST_SUITE(osif_msgq, NULL, NULL, NULL, NULL, NULL);
```

## src/osif_mutex.c
```c
#include <zephyr/ztest.h>
#include <zephyr/kernel.h>
#include <os_task.h>
#include <os_sched.h>
#include <os_sync.h>

#define WAIT_MS      50
#define TIMEOUT_MS   (100 + WAIT_MS)
#define STACKSZ         1024

ZTEST(osif_mutex, test_mutex)
{
	void *mutex_id = NULL;
	bool status;

	/* Try deleting invalid mutex object */
	status = os_mutex_delete(mutex_id);
	zassert_true(status == false,
		     "Invalid Mutex deleted unexpectedly!");

	status = os_mutex_create(&mutex_id);
	zassert_true(status != false, "Mutex1 creation failed");

	/* Try to release mutex without obtaining it */
	status = os_mutex_give(mutex_id);
	zassert_true(status == false, "Mutex released unexpectedly!");

	status = os_mutex_take(mutex_id, 0);
	zassert_true(status == true, "Mutex wait failure");

	/* Try to acquire an already acquired mutex */
	status = os_mutex_take(mutex_id, 0);
	zassert_true(status == true, "Mutex wait failure");

	status = os_mutex_give(mutex_id);
	zassert_true(status == true, "Mutex release failure");

	/* Release mutex again as it was acquired twice */
	status = os_mutex_give(mutex_id);
	zassert_true(status == true, "Mutex release failure");

	/* Try to release mutex that was already released */
	status = os_mutex_give(mutex_id);
	zassert_true(status == false, "Mutex released unexpectedly!");

	status = os_mutex_delete(mutex_id);
	zassert_true(status == true, "Mutex delete failure");
}

void tThread_entry_lock_timeout(void *arg)
{
	bool status;

	/* Mutex cannot be acquired/released here as it is still held
	 * by the other thread. Try with and without timeout.
	 */
	status = os_mutex_take((struct k_mutex *)arg, 0);
	zassert_true(status == false);

	status = os_mutex_take((struct k_mutex *)arg, WAIT_MS);
	zassert_true(status == false);

	status = os_mutex_give((struct k_mutex *)arg);
	zassert_true(status == false, "Mutex unexpectedly released");

	/* This delay ensures that the mutex gets released by the other
	 * thread in the meantime
	 */
	os_delay(TIMEOUT_MS);

	/* Now that the mutex is free, it should be possible to acquire
	 * and release it.
	 */
	status = os_mutex_take((struct k_mutex *)arg, TIMEOUT_MS);
	zassert_true(status == true);
	os_mutex_give((struct k_mutex *)arg);
}

ZTEST(osif_mutex, test_mutex_lock_timeout)
{
	void *tid;
	void *mutex_id;
	bool status;

	status = os_mutex_create(&mutex_id);
	zassert_true(status != false, "Mutex2 creation failed");

	status = os_task_create(&tid, "Mutex_check", tThread_entry_lock_timeout,
                        mutex_id, STACKSZ, 3);
	zassert_true(status != false, "Thread creation failed");

	status = os_mutex_take(mutex_id, 0xFFFFFFFF);
	zassert_true(status == true, "Mutex wait failure");

	/* wait for spawn thread to take action */
	os_delay(TIMEOUT_MS);

	/* Release the mutex to be used by the other thread */
	os_mutex_give(mutex_id);
	os_delay(TIMEOUT_MS);

	status = os_mutex_delete(mutex_id);
	zassert_true(status == true, "Mutex delete failure");

	status = os_task_delete(tid);
	zassert_true(status == true, "Error deleting Mutex_check task");
}
ZTEST_SUITE(osif_mutex, NULL, NULL, NULL, NULL, NULL);
```

## src/osif_sched.c
```c
#include <zephyr/ztest.h>
#include <zephyr/kernel.h>
#include <os_sched.h>
#include <trace.h>

#define WAIT_TIME_US 1000000

/* Specify accepted tolerance. On some Zephyr platforms  (e.g. nRF5x) the busy
 * wait loop and the system timer are based on different mechanisms and may not
 * align perfectly. 1 percent base intolerance is to cover CPU processing in the
 * test.
 */
#define TOLERANCE_PPC 1


/**
 * @brief Test os_sys_time_get
 *
 * @see os_sys_time_get_zephyr()
 */
ZTEST(osif_sched, test_os_sys_time_get)
{
	uint64_t start_time, stop_time, diff, max, min;

	start_time = os_sys_time_get();
	k_busy_wait(WAIT_TIME_US);
	stop_time = os_sys_time_get();

	diff = (uint64_t)(stop_time -
					 start_time) * USEC_PER_MSEC;

	max = WAIT_TIME_US + (TOLERANCE_PPC * WAIT_TIME_US / 100);
	min = WAIT_TIME_US - (TOLERANCE_PPC * WAIT_TIME_US / 100);

	zassert_true(diff <= max && diff >= min,
		     "start %lld stop %lld (diff %lld) wait %d us\n",
		     start_time, stop_time, diff, WAIT_TIME_US);

}
ZTEST_SUITE(osif_sched, NULL, NULL, NULL, NULL, NULL);
```

## src/osif_semaphore.c
```c
#include <zephyr/ztest.h>
#include <zephyr/kernel.h>
#include <os_task.h>
#include <os_sync.h>
#include <os_sched.h>

#define WAIT_MS      50
#define TIMEOUT_MS   (100 + WAIT_MS)
#define STACKSZ         1024

void thread_sema(void *arg)
{
	bool status;

	/* Try taking semaphore immediately when it is not available */
	status = os_sem_take((struct k_sem *)arg, 0);
	zassert_true(status == false,
		     "Semaphore acquired unexpectedly!");

	/* Try taking semaphore after a TIMEOUT, but before release */
	status = os_sem_take((struct k_sem *)arg, WAIT_MS);
	zassert_true(status == false,
		     "Semaphore acquired unexpectedly!");

	/* This delay ensures that the semaphore gets released by the other
	 * thread in the meantime
	 */
	os_delay(TIMEOUT_MS);

	/* Now that the semaphore is free, it should be possible to acquire
	 * and release it.
	 */
	status = os_sem_take((struct k_sem *)arg, 0);
	zassert_true(status == true, "Semaphore could not be acquired");

	zassert_true(os_sem_give((struct k_sem *)arg) == true,
		     "Semaphore release failure");

	/* Try releasing when no semaphore is obtained */
	zassert_true(
		os_sem_give((struct k_sem *)arg) == false,
		"Semaphore released unexpectedly!");
}

ZTEST(osif_semaphore, test_semaphore)
{
	void *semaphore_id;
	bool status;
	void *tid;
	void *dummy_sem_id = NULL;

	status = os_sem_create(&semaphore_id, "mySemaphore", 1, 1);
	zassert_true(status != false, "semaphore creation failed");

	status = os_task_create(&tid, "Sema_check", thread_sema,
                        semaphore_id, STACKSZ, 3);
	zassert_true(status != false, "Failed creating thread3");

	/* Acquire invalid semaphore */
	zassert_equal(os_sem_take(dummy_sem_id, 0xFFFFFFFF),
		      false, "Semaphore wait worked unexpectedly");

	status = os_sem_take(semaphore_id, 0xFFFFFFFF);
	zassert_true(status == true, "Semaphore wait failure");

	/* wait for spawn thread to take action */
	os_delay(TIMEOUT_MS);

	/* Release invalid semaphore */
	zassert_equal(os_sem_give(dummy_sem_id), false,
		      "Semaphore release worked unexpectedly");

	/* Release the semaphore to be used by the other thread */
	status = os_sem_give(semaphore_id);
	zassert_true(status == true, "Semaphore release failure");

	os_delay(TIMEOUT_MS);

	/* Delete invalid semaphore */
	zassert_equal(os_sem_delete(dummy_sem_id), false,
		      "Semaphore delete worked unexpectedly");

	status = os_sem_delete(semaphore_id);
	zassert_true(status == true, "semaphore delete failure");

	status = os_task_delete(tid);
	zassert_true(status == true, "Error deleting Sema_check task");
}
ZTEST_SUITE(osif_semaphore, NULL, NULL, NULL, NULL, NULL);
```

## src/osif_sync.c
```c
#include <zephyr/ztest.h>
#include <zephyr/kernel.h>
#include <os_task.h>
#include <os_sync.h>
#include <os_sched.h>

#define WAIT_MS      50
#define TIMEOUT_MS   (100 + WAIT_MS)
#define STACKSZ         1024

ZTEST(osif_sync, test_os_lock_unlock)
{
    uint32_t key = os_lock();
    zassert_equal(__get_BASEPRI(),_EXC_IRQ_DEFAULT_PRIO,"BASEPRI is not set correctly when calling os_lock");
    os_unlock(key);
    zassert_equal(__get_BASEPRI(),0,"BASEPRI is clear correctly when calling os_unlock");
}
ZTEST_SUITE(osif_sync, NULL, NULL, NULL, NULL, NULL);
```

## src/osif_task_apis.c
```c
#include <zephyr/ztest.h>
#include <zephyr/kernel.h>
#include <os_task.h>
#include <os_sched.h>

#define STACKSZ 2048

/* This is used to check the thread yield functionality between 2 threads */
static int thread_yield_check;

/* This is used to indicate the completion of processing for thread3 */
static int thread3_state;

void thread1(void *argument)
{
	bool status;
	void *id;

	status = os_task_handle_get(&id);

	zassert_true(id != NULL, "os_task_handle_get failed");

	/* This thread starts off at a high priority (same as thread2) */
	thread_yield_check++;
	zassert_equal(thread_yield_check, 1);

	/* Yield to thread2 which is of same priority */
	status = os_task_yield();
	zassert_true(status == true, "Error doing thread yield");

	/* thread_yield_check should now be 2 as it was incremented
	 * in thread2.
	 */
	zassert_equal(thread_yield_check, 2);
}

void thread2(void *argument)
{
	/* By now thread1 would have set thread_yield_check to 1 and would
	 * have yielded the CPU. Incrementing it over here would essentially
	 * confirm that the yield was indeed executed.
	 */
	thread_yield_check++;

	/* Yield back to thread1 which is of same priority */
	os_task_yield();
}

void thread3(void *argument)
{
	bool status;
	uint16_t rv;
	void *id;
	status = os_task_handle_get(&id);
	uint16_t prio;
	status = os_task_priority_get(id,&prio);

	/* Lower the priority of the current thread */
	os_task_priority_set(id, 2);
	status = os_task_priority_get(id,&rv);
	zassert_equal(rv, 2,
			"Expected priority to be changed to %d, not %d",
			(int)2, (int)rv);

	/* Increase the priority of the current thread */
	os_task_priority_set(id, 4);
	status = os_task_priority_get(id,&rv);
	zassert_equal(rv, 4,
			"Expected priority to be changed to %d, not %d",
			(int)4, (int)rv);

	/* Restore the priority of the current thread */
	os_task_priority_set(id, prio);
	status = os_task_priority_get(id,&rv);
	zassert_equal(rv, prio,
			"Expected priority to be changed to %d, not %d",
			(int)prio, (int)rv);

	/* Try to set unsupported priority and assert failure */
	status = os_task_priority_set(id, 7);
	zassert_true(status == false,
			"Something's wrong with os_task_priority_set!");

	/* Indication that thread3 is done with its processing */
	thread3_state = 1;

	/* Keep looping till it gets killed */
	do {
		os_delay(100);
	} while (1);
}

ZTEST(osif_task_apis, test_thread_prio)
{
	void *id3 = NULL;
	uint32_t task_param;
	bool status;

	status = os_task_create(&id3, "task3", thread3,
                        &task_param, STACKSZ, 6);
	zassert_true(status != false, "Failed creating thread3");

	/* Keep delaying 10 milliseconds to ensure thread3 is done with
	 * its execution. It loops at the end and is terminated here.
	 */
	do {
		os_delay(10);
	} while (thread3_state == 0);

	status = os_task_delete(id3);
	zassert_true(status == true, "Error deleting thread3");

	/* Try to set priority to inactive thread and assert failure */
	status = os_task_priority_set(id3, 3);
	zassert_true(status == true,
			"Something's wrong with os_task_priority_set!");

	thread3_state = 0;
}


ZTEST(osif_task_apis, test_thread_apis)
{
	void *id1 = NULL;
	void *id2 = NULL;

	uint32_t task_param;

	bool status;
	status = os_task_create(&id1, "task1",  thread1,
                        &task_param, STACKSZ, 6);
	zassert_true(status != false, "Failed creating thread1");

	status = os_task_create(&id2, "task2", thread2,
                        &task_param, STACKSZ, 6);
	zassert_true(status != false, "Failed creating thread2");


	do {
		os_delay(100);
	} while (thread_yield_check != 2);

}
ZTEST_SUITE(osif_task_apis, NULL, NULL, NULL, NULL, NULL);
```

## src/osif_task_signal.c
```c
#include <zephyr/ztest.h>
#include <zephyr/kernel.h>
#include <os_task.h>
#include <os_sched.h>

#include <zephyr/irq_offload.h>
#include <zephyr/kernel_structs.h>

#define STACKSZ 1024

#define TIMEOUT		(100)
#define SIGNAL1		(0x00000020)
#define SIGNAL2		(0x00000004)
#define SIGNAL		(SIGNAL1 | SIGNAL2)

#define SIGNAL_FLAG 0x00000001
#define ISR_SIGNAL 0x50

#define TIMEOUT_TICKS   (10)
#define FLAG1           (0x00000020)
#define FLAG2           (0x00000004)
#define FLAG            (FLAG1 | FLAG2)
#define ISR_FLAG        (0x50)

static void thread1(void *arg)
{
	/* wait for FLAG1. It should return immediately as it is
	 * triggered but cleared.
	 */
	bool status;
	uint32_t p_signal;
	status = os_task_signal_recv(&p_signal, TIMEOUT_TICKS);
	zassert_equal(status, false,
		      "signal wait successed unexpectedly, means signal clear is not working!");
}

static void thread2(void *arg)
{
	bool status;
	uint32_t p_signal;
	status = os_task_signal_recv(&p_signal, TIMEOUT_TICKS);
	zassert_equal(status, true,
		      "signal wait failed unexpectedly");
	zassert_equal(p_signal & FLAG, FLAG,
		      "os_task_signal_recv failed unexpectedly");

	/* validate by passing invalid parameters */
	zassert_equal(os_task_signal_send(NULL, 0), false,
		      "os_task_signal_send: Invalid Task Handle is unexpectedly working!");
}

ZTEST(osif_task_signal, test_task_signal_clear)
{
	void *id1 = NULL;
	uint32_t task_param;
	bool status;
	status = os_task_create(&id1, "task2",  thread1,
                        &task_param, STACKSZ, 6);
	zassert_true(status != false, "Failed creating thread2");

	status = os_task_signal_send(id1, FLAG1);
	zassert_true(status == true, "os_task_signal_send fail");

	status = os_task_signal_clear(id1);
	zassert_true(status == true, "os_task_signal_clear fail");

	status = os_task_signal_clear(NULL);
	zassert_true(status == false, "os_task_signal_clear: Invalid Task Handle is unexpectedly working!");

	os_delay(TIMEOUT_TICKS / 2);

	status = os_task_delete(id1);
	zassert_true(status != false, "Thread delete failed");
}


ZTEST(osif_task_signal, test_task_signalled)
{
	void *id2 = NULL;
	uint32_t task_param;
	bool status;
	status = os_task_create(&id2, "task2",  thread2,
                        &task_param, STACKSZ, 6);
	zassert_true(status != false, "Failed creating thread2");

	status = os_task_signal_send(id2, FLAG1);
	zassert_true(status == true, "os_task_signal_send fail");

	status = os_task_signal_send(id2, FLAG2);
	zassert_true(status == true, "os_task_signal_send fail");

	/* ZTEST_THREAD has a higher priority over the other threads.
	 * Hence, this thread needs to be put to sleep for thread2
	 * to become the active thread.
	 */
	os_delay(TIMEOUT_TICKS / 2);

	status = os_task_delete(id2);
	zassert_true(status != false, "Thread delete failed");
}

/* IRQ offload function handler to set signal flag */
static void offload_function(const void *param)
{
	k_tid_t tid = (k_tid_t)param;

	/* Make sure we're in IRQ context */
	zassert_true(k_is_in_isr(), "Not in IRQ context!");

	bool status = os_task_signal_send(tid, ISR_SIGNAL);
	zassert_not_equal(status, false, "signal set failed in ISR");
}

void test_signal_from_isr(void *param)
{
	void *id;
	bool status;
	uint32_t p_signal;

	status = os_task_handle_get(&id);
	/**TESTPOINT: Offload to IRQ context*/
	irq_offload(offload_function, (const void *)id);
	
	status = os_task_signal_recv(&p_signal, TIMEOUT);
	zassert_equal(status, true,
		      "signal wait failed unexpectedly");
	zassert_equal((p_signal & ISR_SIGNAL),
		       ISR_SIGNAL, "unexpected signal wait value");
}

ZTEST(osif_task_signal, test_signal_events_isr)
{
	void *id3 = NULL;
	uint32_t task_param;

	bool status;
	status = os_task_create(&id3, "test_signal_from_isr", test_signal_from_isr,
                        &task_param, STACKSZ, 6);

	zassert_true(status != false, "Thread creation failed");

	os_delay(1000);

	status = os_task_delete(id3);
	zassert_true(status != false, "Thread delete failed");
}
ZTEST_SUITE(osif_task_signal, NULL, NULL, NULL, NULL, NULL);
```

## src/osif_timer.c
```c
#include <zephyr/ztest.h>
#include <os_timer.h>
#include <os_sched.h>

#define ONESHOT_TIME_MS      200
#define PERIOD_MS            100
#define NUM_PERIODS             5

#define TIMER_ID1 1
#define TIMER_ID2 2

uint32_t num_oneshots_executed;
uint32_t num_periods_executed;


void Timer1_Callback(void *arg)
{
	uint32_t timer_id;

	os_timer_id_get(&arg, &timer_id);
	zassert_equal(timer_id, TIMER_ID1, "Error getting Timer ID!");

	num_oneshots_executed++;
	TC_PRINT("oneshot_callback (Timer %d) = %d\n",
		 timer_id, num_oneshots_executed);
}

void Timer2_Callback(void *arg)
{
	uint32_t timer_id;

	os_timer_id_get(&arg, &timer_id);
	zassert_equal(timer_id, TIMER_ID2, "Error getting Timer ID!");

	num_periods_executed++;
	TC_PRINT("periodic_callback (Timer %d) = %d\n",
		 timer_id, num_periods_executed);
}


ZTEST(osif_timer, test_timer)
{
	void *timer1 = NULL;
	void *timer2 = NULL;
	bool status;

	/* Create one-shot timer */
	status = os_timer_create(&timer1, "timer1", TIMER_ID1, ONESHOT_TIME_MS, false, Timer1_Callback);
	zassert_true(status != false, "error creating one-shot timer");

/* zephyr not support os_timer_handle_get yet*/
	// void *handle_get;
	// status = os_timer_handle_get(&handle_get,TIMER_ID1);
	// zassert_equal(handle_get, timer1, "Error getting Timer handle!");

	/* Stop the timer before start */
	status = os_timer_stop(&timer1);
	zassert_true(status == false,
		     "error while stopping non-active timer");

	status = os_timer_start(&timer1);
	zassert_true(status == true, "error starting one-shot timer");

	uint8_t state;
	os_timer_state_get(&timer1, &state);
	zassert_equal(state, 1, "Error: Timer not running");

	/* Timer should fire only once if setup in one shot
	 * mode. Wait for 3 times the one-shot time to see
	 * if it fires more than once.
	 */
	os_delay(ONESHOT_TIME_MS * 3U + 10);
	zassert_true(num_oneshots_executed == 1U,
		     "error setting up one-shot timer (using os_timer_start)");

	status = os_timer_stop(&timer1);
	zassert_true(status == true, "error stopping one-shot timer");

	status = os_timer_restart(&timer1, ONESHOT_TIME_MS * 2);
	zassert_true(status == true, "error restarting one-shot timer");

	os_delay(ONESHOT_TIME_MS * 6U + 15);
	zassert_true(num_oneshots_executed == 2U,
		     "error setting up one-shot timer (using os_timer_restart)");

	status = os_timer_delete(&timer1);
	zassert_true(status == true, "error deleting one-shot timer");

	/* Create periodic timer */
	status = os_timer_create(&timer2, "timer2", TIMER_ID2, PERIOD_MS, true, Timer2_Callback);
	zassert_true(status != false, "error creating periodic timer");

	os_timer_state_get(&timer2, &state);
	zassert_equal(state, 0, "Error: Timer is running");

	status =  os_timer_start(&timer2);
	zassert_true(status == true, "error starting periodic timer");

	/* Timer should fire periodically if setup in periodic
	 * mode. Wait for NUM_PERIODS periods to see if it is
	 * fired NUM_PERIODS times.
	 */
	os_delay(PERIOD_MS * NUM_PERIODS + 10);

	zassert_true(num_periods_executed == NUM_PERIODS,
		     "error setting up periodic timer (using os_timer_start)");

	status =  os_timer_restart(&timer2, PERIOD_MS * 2);
	zassert_true(status == true, "error starting periodic timer");

	os_delay(PERIOD_MS * NUM_PERIODS * 2 + 10);
	zassert_true(num_periods_executed == NUM_PERIODS * 2,
		     "error setting up periodic timer (using os_timer_restart)");

	/* Delete the timer before stop */
	status = os_timer_delete(&timer2);
	zassert_true(status == true, "error deleting periodic timer");
}
ZTEST_SUITE(osif_timer, NULL, NULL, NULL, NULL, NULL);
```

## src/vector_update.c
```c
#include <zephyr/ztest.h>
#include <zephyr/kernel.h>
#include <soc.h>

extern IRQ_Fun *WrapperVectorTable;
extern void isr_wrapper(void);
typedef void (*zephyr_isr)(const void *);

void test_isr_xip(const void *)
{
    return;
}

__ramfunc
void test_isr_ram(const void *)
{
    return;
}

ZTEST(rtk_vector_update, test_RamVectorTableUpdate)
{
    //Test first level interrupt (xip isr)
    struct _isr_table_entry *entry = &_sw_isr_table[ASRC0_IRQn];
    zassert_equal(z_irq_spurious, entry->isr, "Wrong! The isr on zephyr sw isr table should be z_irq_spurious because it is not registered yet!");
    RamVectorTableUpdate(ASRC0_VECTORn, (IRQ_Fun)test_isr_xip);
    zassert_equal((zephyr_isr)isr_wrapper, entry->isr, "Wrong! The isr on zephyr sw isr table should be isr_wrapper(rtk vesion) because it is a xip isr!");
    zassert_equal(WrapperVectorTable[ASRC0_VECTORn], (IRQ_Fun)test_isr_xip, "Wrong! The isr on rtk wrapper table should be test_isr!");

    //Test first level interrupt (ram isr)
    RamVectorTableUpdate(ASRC0_VECTORn, (IRQ_Fun)test_isr_ram);
    zassert_equal(test_isr_ram, entry->isr, "Wrong! The isr on zephyr sw isr table should be test_isr_ram!");
}
ZTEST_SUITE(rtk_vector_update, NULL, NULL, NULL, NULL, NULL);
```
