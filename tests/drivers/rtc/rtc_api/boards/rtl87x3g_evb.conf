## tests/drivers/rtc/rtc_api/boards/rtl87x3g_evb.conf
```kconfig
# Copyright(c) 2024, Realtek Semiconductor Corporation.
# SPDX-License-Identifier: Apache-2.0

CONFIG_RTC_RTL87X3G=y
CONFIG_RTC_ALARM=y
CONFIG_RTC_UPDATE=y
```

## tests/drivers/spi/spi_controller_peripheral/boards/rtl87x3g_evb.conf
```kconfig
CONFIG_TESTED_SPI_MODE=1
# dma is optional
# CONFIG_SPI_RTL87X3G_DMA=y
# CONFIG_HEAP_MEM_POOL_SIZE=256
```

## tests/drivers/spi/spi_loopback/boards/rtl87x3g_evb.conf
```kconfig
CONFIG_GPIO=y
CONFIG_SPI_ASYNC=y
# dma is optional
CONFIG_SPI_RTL87X3G_DMA=y
CONFIG_HEAP_MEM_POOL_SIZE=256
```

## tests/subsys/portability/realtek_osif/testcase.yaml
```yaml
tests:
  portability.realtek_osif:
    tags: realtek_osif
    min_ram: 32
    min_flash: 34
```
